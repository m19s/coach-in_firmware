## esp32/components/GROOVE/Kconfig
```kconfig
menu "GROOVE Component Settings"

choice GROOVE_HAND
    prompt "Device settings"
    default GROOVE_HAND_LEFT
    help
	    Choose the side of groove device.

config GROOVE_HAND_LEFT
    bool "LEFT HAND"
config GROOVE_HAND_RIGHT
    bool "RIGHT HAND"
endchoice

choice GROOVE_TARGET
    prompt "Build target"
    default GROOVE_TARGET_DEVICE
    help
	    Build settings for each target. When build as a real device, all modules are initialized like a IMU.

config GROOVE_TARGET_DEVICE
    bool "Real device"
config GROOVE_TARGET_DEV_BOARD
    bool "Development board"
endchoice

choice GROOVE_INTERFACE
    prompt "Network Interface"
    default GROOVE_INTERFACE_BLE

config GROOVE_INTERFACE_BLE
    bool "Bluetooth Low Energy"
config GROOVE_INTERFACE_IM920
    bool "IM920"
config GROOVE_INTERFACE_WIRE
    bool "Wire"
endchoice

config GROOVE_DEVICE_NAME
    string "Input a name of GROOVE"
    help
	    The name will appear in an app.

config GROOVE_DEVICE_UDID
    int "Set UDID of GROOVE"
    range 1 15
    default 1
    help
	    The name will appear in an app.

endmenu
```

## esp32/components/coach-in/Kconfig
```kconfig
menu "coach-in Component Settings"

choice COACH_IN_HAND
    prompt "Device settings"
    default COACH_IN_HAND_LEFT
    help
	    Choose the side of groove device.

config COACH_IN_HAND_LEFT
    bool "LEFT HAND"
config COACH_IN_HAND_RIGHT
    bool "RIGHT HAND"
endchoice

config COACH_IN_DEVICE_NAME
    string "Device name"
	default "DEBUG"
    help
	    The name will appear in an app.
endmenu
```
